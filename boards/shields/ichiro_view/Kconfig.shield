## boards/shields/ichiro_view/Kconfig.shield
```kconfig
# Copyright (c) 2022 The ZMK Contributors
# SPDX-License-Identifier: MIT

config SHIELD_ICHIRO_VIEW
    def_bool $(shields_list_contains,ichiro_view)
```
